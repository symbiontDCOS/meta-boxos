## meta-boxos/conf/distro/boxos.conf
```bitbake
# Distro Layer configuration
#include conf/distro/poky.conf
DISTRO = "boxos"
DISTRO_NAME = "BoxOS (Namespace Operating System)"
DISTRO_VERSION = "0.1"
DISTRO_CODENAME = "Jackal"
SDK_VENDOR = "-boxossdk"
SDK_VERSION="${DISTRO_VERSION}"
MAINTAINER = "info@boxos.com"

# Use systemd as init manager
DISTRO_FEATURES_append = " systemd virtualization"
DISTRO_FEATURES_BACKFILL_CONSIDERED += "sysvinit"
VIRTUAL-RUNTIME_init_manager = "systemd"
VIRTUAL-RUNTIME_initscripts = "systemd-compat-units" 
```

## meta-boxos/conf/layer.conf
```bitbake
# We have a conf and classes directory, add to BBPATH
BBPATH .= ":${LAYERDIR}"

# We have recipes-* directories, add to BBFILES
BBFILES += "${LAYERDIR}/recipes-*/*/*.bb \
            ${LAYERDIR}/recipes-*/*/*.bbappend"

BBFILE_COLLECTIONS += "meta-boxos"
BBFILE_PATTERN_meta-boxos = "^${LAYERDIR}/"
BBFILE_PRIORITY_meta-boxos = "6"

LAYERDEPENDS_meta-boxos = "core"
LAYERSERIES_COMPAT_meta-boxos = "dunfell thud"
```
